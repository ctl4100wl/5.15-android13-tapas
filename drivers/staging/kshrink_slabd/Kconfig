## drivers/staging/kshrink_slabd/Kconfig
```kconfig
config KSHRINK_SLABD
	tristate "OnePlus memload optimization"
	help
	  OnePlus memload optimization to transform synchronous shrink_slab()
	  into non-blocking shrink_async() to improve performance on low-latency 
	  systems
```
